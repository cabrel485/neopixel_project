## my_w2812b_Project/W2812bDesignIP_INTEGRATED/W2812bDesignIP_INTEGRATED.sdk/w2812b-zedboard/build/misc/rootfs_config/Kconfig.user
```kconfig
menu "apps " 
config gpio-demo  
	 bool "gpio-demo"
	 help
	 gpio-demo application
	
config myapp  
	 bool "myapp"
	 help
	 Simple myapp application
	
config peekpoke  
	 bool "peekpoke"
	 help
	 peekpoke application
	
endmenu
menu "user packages " 
endmenu
```
